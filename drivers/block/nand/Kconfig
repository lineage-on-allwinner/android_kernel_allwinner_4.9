## drivers/block/nand/Kconfig
```kconfig
config SUNXI_NAND
	tristate  "The sunxi nand driver"
	default n
	help
	  The nand used on the platform.

	  If unsure, say m.

source "drivers/block/nand/common1/Kconfig"
```
